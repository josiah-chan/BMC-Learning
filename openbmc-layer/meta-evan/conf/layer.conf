## openbmc-layer/meta-evan/conf/layer.conf
```bitbake
# We have a conf and classes directory, add to BBPATH
BBPATH .= ":${LAYERDIR}"

# We have recipes-* directories, add to BBFILES
BBFILES += "${LAYERDIR}/recipes-*/*/*.bb \
            ${LAYERDIR}/recipes-*/*/*.bbappend"

BBFILE_COLLECTIONS += "meta-evan"
BBFILE_PATTERN_meta-evan = "^${LAYERDIR}/"
BBFILE_PRIORITY_meta-evan = "6"

LAYERDEPENDS_meta-evan = "core"
LAYERSERIES_COMPAT_meta-evan = "scarthgap styhead"
IMAGE_INSTALL:append = " devmemtool scutool"
```
